## Kconfig
```kconfig
mainmenu "C/CPP CMake project framework Kconfig configuration"

menu "Toolchain configuration"
	config TOOLCHAIN_PATH
		string "toolchain path"
		default "/opt/kendryte-toolchain/bin"
	
	config TOOLCHAIN_PREFIX
		string "toolchain prefix"
		default "riscv64-unknown-elf-"
endmenu

menu "Components configuration"
	osource "${SDK_PATH}/components/*/Kconfig"
endmenu

osource "${PROJECT_PATH}/*/Kconfig"
```

## components/drivers/camera/Kconfig
```kconfig
menu "Camera( Sensor ) configuration"

    comment "SELECT CAMERA TYPE"

    config ENABLE_CAMERA
        bool "enable camera"
        default y

    choice CAMERA_TYPE
        depends on ENABLE_CAMERA
        bool "Camera type"
        default CAMERA_OV2640

        config CAMERA_OV2640
            bool "single ov2640"
        config CAMERA_GC0328
            bool "single gc0328"
        config CAMERA_OV5640
            bool "single ov5640"
    endchoice

    menu "DVP pin configuration"
        depends on  ENABLE_CAMERA 
        config PIN_CMOS_RST
            int "Pin CMOS_RST"
            default 42
        config PIN_CMOS_PWDN
            int "Pin CMOS_PWDN"
            default 44
        config PIN_CMOS_XCLK
            int "Pin CMOS_XCLK"
            default 46
        config PIN_CMOS_VSYNC
            int "Pin CMOS_VSYNC"
            default 43

        config PIN_CMOS_HREF
            int "Pin CMOS_HREF"
            default 45
        config PIN_CMOS_PCLK
            int "Pin CMOS_PCLK"
            default 47
        config PIN_SCCB_SCLK
            int "Pin SCCB_SCLK"
            default 41
        config PIN_SCCB_SDA
            int "Pin SCCB_SDA"
            default 40
    endmenu

    config CAMERA_RESOLUTION_WIDTH
        depends on ENABLE_CAMERA
        int "Camera resolution width"
        default 320
    config CAMERA_RESOLUTION_HEIGHT
        depends on ENABLE_CAMERA
        int "Camera resolution height"
        default 240
endmenu
```

## components/drivers/lcd/Kconfig
```kconfig
menu "LCD configuration"

    config ENABLE_LCD
        bool "enable lcd"
        default y

    menu "Lcd ( Display ) configuration"
        depends on ENABLE_LCD

        config LCD_WIDTH
            depends on ENABLE_LCD
            int "Lcd display size width"
            default 320
        config LCD_HEIGHT
            depends on ENABLE_LCD
            int "Lcd display size height"
            default 240

        config LCD_CLK_FREQ_MHZ
            depends on ENABLE_LCD
            int "lcd clk frequency MHZ"
            default 20
    endmenu

    menu "LCD Pin configuration"
        depends on ENABLE_LCD

        config PIN_NUM_LCD_RST
            int "LCD Pin RST"
            default 37
        config PIN_NUM_LCD_DCX
            int "LCD Pin DCX"
            default 38
        config PIN_NUM_LCD_WRX
            int "LCD Pin WRX"
            default 36
        config PIN_NUM_LCD_SCK
            int "LCD Pin SCK"
            default 39
        config SPI_CHANNEL
            int "spi channel"
            default 0
        config SPI_SLAVE_SELECT
            int "spi slave select"
            default 3
    endmenu

    menu "LCD Pin Func configuration"
        depends on ENABLE_LCD

        config GPIOHS_NUM_LCD_DCX
            int "LCD Pin DCX bind with GPIOHS num"
            default 2
        config GPIOHS_NUM_LCD_RST
            int "LCD Pin RST bind with GPIOHS num"
            default 3
    endmenu

endmenu
```

## components/drivers/sd_card/Kconfig
```kconfig
menu "SPI TF card configuration"

    config ENABLE_SD_CARD
        bool "Enable SPI TF card"
        default n

    menu "SPI TF card configuration"
        depends on ENABLE_SD_CARD

        config PIN_NUM_SD_CARD_SCLK
            int "SPI TF card SCLK pin number"
            default 27
        config PIN_NUM_SD_CARD_MOSI
            int "SPI TF card MOSI pin number"
            default 28
        config PIN_NUM_SD_CARD_MISO
            int "SPI TF card MISO pin number"
            default 26
        config PIN_NUM_SD_CARD_CS
            int "SPI TF card CS pin number"
            default 29
    endmenu

endmenu
```

## components/drivers/w25q_flash/Kconfig
```kconfig
menu "FLASH configuration"

    config ENABLE_FLASH
        bool "enable flash"
        default y
endmenu
```

## components/utils/Kconfig
```kconfig
menu "utils config"

    config ENABLE_JPEG_DECODE
        bool "enable jpeg decode"
        default n
        select ENABLE_SD_CARD

    config ENABLE_JPEG_ENCODE
        bool "enable jpeg encode"
        default n
        select ENABLE_SD_CARD
endmenu
```

## projects/dvp2lcd/main/Kconfig
```kconfig
menu "Application configuration"

	menu "Board Type Select"

		choice BBOARD_TYPE
			bool "board type"
			default MAIX_DOCK
				
		config MAIX_DOCK
			bool "default DOCK board"

		config SELF_DEFINE			
			bool "client 1 board"
		endchoice
		
	endmenu

			
	menu "Drivers configuration"
		# camera
		osource "${SDK_PATH}/components/drivers/camera/Kconfig"
	
		# lcd
		osource "${SDK_PATH}/components/drivers/lcd/Kconfig"
	
		#flash
		osource "${SDK_PATH}/components/drivers/flash/Kconfig"
		
		# sd_card
		osource "${SDK_PATH}/components/drivers/sd_card/Kconfig"
	
	endmenu


endmenu
```

## projects/dvp2sdcard/main/Kconfig
```kconfig
menu "Application configuration"

	menu "Board Type Select"

		choice BBOARD_TYPE
			bool "board type"
			default MAIX_DOCK
				
		config MAIX_DOCK
			bool "default DOCK board"

		config SELF_DEFINE			
			bool "client 1 board"
		endchoice
		
	endmenu

			
	menu "Drivers configuration"
		# camera
		osource "${SDK_PATH}/components/drivers/camera/Kconfig"
	
		# lcd
		osource "${SDK_PATH}/components/drivers/lcd/Kconfig"
	
		#flash
		osource "${SDK_PATH}/components/drivers/flash/Kconfig"
		
		# sd_card
		osource "${SDK_PATH}/components/drivers/sd_card/Kconfig"
	
	endmenu

	menu "IMAGE FORMAT setting"
		comment "SAVE IMAGE TO sd_card BY PRESS KEY"
		config KEY_SAVE
			bool "enable key save"
			default n
			select ENABLE_SD_CARD
			
		config KEY_BTN_NUM
			depends on KEY_SAVE
			int "key button number"
			default 16
		config KEY_BTN_NUM_GPIOHS
			depends on KEY_SAVE
			int "gpiohs key button number"
			default 0

		config IMAGE_SUFFIX
			depends on KEY_SAVE
			string "image suffix to save, jpg or bmp"
			default bmp
		config JPEG_BUF_LEN
			depends on IMAGE_SUFFIX="jpg"
			int "JPEG image size(KB) buffer"
			default 30
		config JPEG_COMPRESS_QUALITY
			depends on IMAGE_SUFFIX="jpg"
			int "JPEG compress quality"
			default 90	
	endmenu

	menu "READ IMAGE"
		comment "READ IMAGE FROM SDCARD"
		config READ_IMG_SDCARD
			bool "read jpg from sd_card"
			default n
			select ENABLE_JPEG_DECODE
			
	endmenu

endmenu
```

## projects/espwifi/main/Kconfig
```kconfig
menu "Application configuration"

	menu "Board Type Select"

		choice BBOARD_TYPE
			bool "board type"
			default MAIX_DOCK
				
		config MAIX_DOCK
			bool "default DOCK board"

		config SELF_DEFINE			
			bool "client 1 board"
		endchoice
		
	endmenu

			
	menu "Drivers configuration"
		# camera
		osource "${SDK_PATH}/components/drivers/camera/Kconfig"
	
		# lcd
		osource "${SDK_PATH}/components/drivers/lcd/Kconfig"
	
		#flash
		osource "${SDK_PATH}/components/drivers/flash/Kconfig"
		
		# sd_card
		osource "${SDK_PATH}/components/drivers/sd_card/Kconfig"
	
	endmenu

	menu "NetWork"
		config NET_ENABLE
			bool "enable network"
			default n

		choice NET_IF_TYPE
			depends on NET_ENABLE
			bool "net interface type"
			default NET_ESP8285

			config NET_ESP8285
				bool "wifi, use esp8285"
				select ENABLE_WIFI
				---help---
				MF1 with M1w have a esp8285

			config NET_W5500
				bool "ethernet, use w5500"
				select ENABLE_W5500
				---help---
				should have a extended w5500 board
		endchoice

		menu "WiFi configuration"
			depends on NET_ESP8285

			config ENABLE_WIFI
				bool "enable wifi over esp8285"
				default y

			menu "WiFi Pin configuration"
				config PIN_NUM_WIFI_EN
					int "WiFi enable pin number"
					default 8
				config PIN_NUM_WIFI_TX
					int "wifi TX pin number"
					default 6
				config PIN_NUM_WIFI_RX
					int "wifi RX pin number"
					default 7

				comment "-------------------------"	

				config PIN_NUM_WIFI_SPI_SCLK 
					depends on ENABLE_WIFI
					int "WiFi simulate SPI SCLK pin"
					default 1
				config PIN_NUM_WIFI_SPI_MOSI
					depends on ENABLE_WIFI
					int "WiFi simulate SPI MOSI pin"
					default 3
				config PIN_NUM_WIFI_SPI_MISO
					depends on ENABLE_WIFI
					int "WiFi simulate SPI MISO pin"
					default 2
				config PIN_NUM_WIFI_SPI_CS
					depends on ENABLE_WIFI
					int "WiFi simulate SPI CS pin"
					default 0
			endmenu

			menu "WiFi Pin Func configuration"
			config GPIOHS_NUM_WIFI_EN 
				int "WiFi enable gpiohs number"
				default 15

			config GPIO_NUM_WIFI_TX
				int "WiFi Tx gpiohs number"
				default 0

			config GPIO_NUM_WIFI_RX
				int "WiFi Rx gpiohs number"
				default 1

			comment "-------------------------"	

			config GPIOHS_NUM_WIFI_SPI_CS
				depends on ENABLE_WIFI
				int "WiFi Spi Cs gpiohs number"
				default 16
			endmenu
		endmenu

		menu "W500 configuration"
			depends on NET_W5500

			config ENABLE_W5500
				bool "enable ethernet over w5500"
				default n

			menu "W5500 Pin configuration"
				depends on ENABLE_W5500

				config PIN_NUM_ETH_W5500_MOSI 
					int "Ethernet Spi mosi pin"
					default 13

				config PIN_NUM_ETH_W5500_MISO
					int "Ethernet Spi miso pin"
					default 12

				config PIN_NUM_ETH_W5500_SCLK
					int "Ethernet Spi sclk pin"
					default 14

				config PIN_NUM_ETH_W5500_CS
					int "Ethernet Spi cs pin"
					default 31

				config PIN_NUM_ETH_W5500_RST
					int "Ethernet rst pin"
					---help---
					default not use this one pin
			endmenu

			menu "W5500 Pin Func configuration"
				depends on ENABLE_W5500

				config GPIOHS_NUM_W5500_CS
					int "GPIOHS num of Ethernet W5500's cs pin"
					default 15

				config GPIOHS_NUM_W5500_RST
					int "GPIOHS num of Ethernet W5500's rst pin"
					default 16
			endmenu
		endmenu

	endmenu

endmenu
```
